## firmware/examples/esp32-p4-01-uart/sdkconfig.defaults
```kconfig
CONFIG_IDF_TARGET="esp32p4"

CONFIG_ESPTOOLPY_FLASHSIZE_16MB=y
CONFIG_SPIRAM=y
CONFIG_SPIRAM_SPEED_80M=y
CONFIG_FREERTOS_HZ=1000


#CONFIG_PARTITION_TABLE_CUSTOM=y
CONFIG_SPIRAM_ALLOW_BSS_SEG_EXTERNAL_MEMORY=y
CONFIG_SPIRAM_USE_MALLOC=y
```
